## conf/layer.conf
```bitbake
# We have a conf and classes directory, add to BBPATH
BBPATH .= ":${LAYERDIR}"

# We have recipes-* directories, add to BBFILES
BBFILES += "${LAYERDIR}/recipes-*/*/*.bb \
            ${LAYERDIR}/recipes-*/*/*.bbappend"

BBFILE_COLLECTIONS += "c1tech"
BBFILE_PATTERN_c1tech = "^${LAYERDIR}/"
BBFILE_PRIORITY_c1tech = "5"

LAYERVERSION_c1tech = "4"
LAYERSERIES_COMPAT_c1tech = "dunfell"
```
